/* -----------------------------------------------------------------------------------------   
* AGTDASAVDCWTSCOVrVam also known more succinctly as AGTD: Automatic GBG Texture Drawing
* v0.7-beta
* Made for Arduino Leonardo by Borri
* Original idea by Scrubz
*
* IMPORTANT DEPENDENCIES:
* Libraries Dependency:    MouseTo by per1234 https://github.com/per1234/MouseTo/
* You can download libraries dependencies under Arduino Official IDE [Tools]/[Manage Libraries]
* 
* AGTDASAVDCWTSCOVrVam is licensed under the MIT License
* ------------------------------------------------------------------------------------------*/

                                 
/*------------------------------------------------------------------------------------------
*                                          CONFIG
* ------------------------------------------------------------------------------------------
* NO_BUTTON
* If don't have a button, or a wire to simulate it, to connect to the Arduino Leonardo
* You must un-comment both lines:
*     #define NO_BUTTON                 No Wire Option
*     #define NO_BUTTON_DELAY   30      No Wire Option. Delay time before the program
*                                       takes control of the mouse. Represented in seconds
* ------------------------------------------------------------------------------------------

//  #define NO_BUTTON
//  #define NO_BUTTON_DELAY   30

/*------------------------------------------------------------------------------------------
* If button/Wire is present, define the Arduino input board PIN
* Default option:
*    #define BUTTON_PIN    9           Button input set to Leonardo pin 9
* ------------------------------------------------------------------------------------------*/

#define BUTTON_PIN    12


/*------------------------------------------------------------------------------------------
* MASK - Use "mask" mode
* This mode is less pleasing to watch draw but improves the speed of the general
* process.
*    #define MASK_ENABLED
* ------------------------------------------------------------------------------------------*/    

#define MASK_ENABLED


/*------------------------------------------------------------------------------------------
* SLOW MODE - For projects with a lot of nodon a delay has to be added to avoid lag induced
* miss-clicks on the GBG Program screen. Recommended values are:
* 
* Recommended option for new GBG projects (Programming screen with minimal lag):
*    int delay_move = 0;
*    int delay_mouse = 0;
*
* Recommended option for existing GBG projects (Programming screen with medium-high lag):
*    int delay_move = 20;
*    int delay_mouse = 50;
*    
* Adjust "delay_move" and "delay_mouse" values if you still encounter problems.     
* ------------------------------------------------------------------------------------------*/

int delay_move = 0;
int delay_mouse = 0;
    
	
/*------------------------------------------------------------------------------------------
* SD/MicroSD Card Reader
* Un-Comment the 2 lines if SD/Micro is present
* If there is an error with the SPI the Arduino builtin led will blink fast indefinitely after
* powering the Arduino.
*   #define SPI_ON
*   #define SPI_CS_PIN 4
* ------------------------------------------------------------------------------------------*/

// #define SPI_ON   
// #define SPI_CS_PIN 4             // CS SPI pin to Arduino Leonardo pin 4
               
/*------------------------------------------------------------------------------------------ *
* If you DON'T have a SPI module connected to the Arduino Leonardo you can use the Arduino
* Leonardo SRAM instead using the "Basic Mode".
* Just check SPI_ON is not active and copy your own csv texture images on the data image space
* a few lines below.
* Nothing else need to be changed.
* ------------------------------------------------------------------------------------------*/

#if !defined(SPI_ON) 
byte image_index = 0;
const PROGMEM byte image[] =
{
/* -----------------------------------------------------------------------------------------
* BASIC MODE
* First remove the example data and paste your own images (Max. 5 images). The data will be
* saved into flash memory, instead of SRAM, where it would normally go.
* Each individual "image data" has to end with a comma if there is another image afterwards.
* ------------------------------------------------------------------------------------------
* The included example textures were created specifically to demonstrate the strength and
* versatility of this process. Special thanks to (in order of image):
* Author: Voxy             Title: Colorful Bunny 
* Author: renS             Title: Romance Painting
* Author: arch             Title: Brick 03
* Author: mercuryangel23   Title: Mousey and Mousey
* Author: VideoDojo        Title: Tutorial Pig
* ------------------------------------------------------------------------------------------
*                             DATA IMAGE SPACE - START
*                         - COPY HERE YOUR .CSV TEXTURES -
* ------------------------------------------------------------------------------------------*/
117,117,27,117,27,117,27,117,27,117,27,117,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115,
/* -----------------------------------------------------------------------------------------
*                              DATA IMAGE SPACE - END
* ------------------------------------------------------------------------------------------*/
}; 
int num_textures = sizeof(image)/4097;
#else
// include the SD library:
#include <SPI.h>
#include <SD.h>
// set up variables using the SD utility library functions:
Sd2Card card;
SdVolume volume;
File root;
File texture;
const int chipSelect = SPI_CS_PIN;
int num_textures;
#endif

 
#include <Mouse.h>
#include <MouseTo.h>                    // Remember to add this library from Tools/Manage Libraries

#if defined(MASK_ENABLED)
byte s_mask[513];
#endif

byte actual_pixel;
byte last_pixel;
byte used_colors[135];
byte used_colors_pointer = 0;
bool used_color;
int pos_x;
int pos_y;


void setup(void) {

  Mouse.begin();
  MouseTo.setScreenResolution(1280,720);
  MouseTo.setCorrectionFactor(1);
  MouseTo.setMaxJump(127);

  
  pinMode(LED_BUILTIN, OUTPUT);
  pinMode(BUTTON_PIN, INPUT_PULLUP);

  #if defined(SPI_ON) 
  
  if (!SD.begin(chipSelect)) {
    // Initialization failed! The builtin led from arduino while blink fast
    // to indicates there is some issue with the SPI.
    while (1) {
      digitalWrite(LED_BUILTIN, HIGH);
      delay(100);
      digitalWrite(LED_BUILTIN, LOW);
      delay(100);;
    }
  }
  
  num_textures = 0;

  root = SD.open("/");
  root.rewindDirectory();
  while (File entry = root.openNextFile()) {
    String filename = entry.name();   
    if (filename.endsWith(".GTD")) {
      num_textures++;
    }
  }
  root.rewindDirectory();

  #endif

  #if defined(NO_BUTTON)
  delay(NO_BUTTON_DELAY*1000);
  #else
  while (digitalRead(BUTTON_PIN) == HIGH) {
    delay(500);
  }
  #endif  

  // First move to get real mouse position
  MouseTo.setTarget(0,0);
  while (MouseTo.move() == false) {}
  delay(1000);

}


void loop() {

  for (int n=0; n<num_textures; n++) {

    createTextureNodon(n);
    clearUsedColorsArray();
  
    // Get first pixel data from image -> Represent the most used color on the image and it is used as Background color.
    #if defined(SPI_ON)    
    while (File entry = root.openNextFile()) {
      String filename = entry.name();   
      if (filename.endsWith(".GTD")) {
        texture = SD.open(filename);
        break;
      }
    }
    texture.seek(0);
    actual_pixel = texture.read();
    #else 
    actual_pixel = pgm_read_byte_near(image + (image_index*4097) );
    #endif
    
    // --------------------------------------------------------------------------------------------------------------------
    
    if (actual_pixel!=47) {       //As new textures has a transparent background we don't have to fill-bucket the canvas if the most used color is "transparent"    
      moveMouseTo(1187, 544);                                  //Mouse click to open  "Palette gear tool/Colour Palette"
      getColor(actual_pixel);                                  //Get color from the Palette
      moveMouseTo(1221, 55);                                   //Mouse click on "X" to exit palette
      moveMouseTo(958, 268);                                   //Mouse click on "Bucket Tool"
      moveMouseTo(809, 277);                                   //Just giving a close coord over the canvas to click-fill the background
      moveMouseTo(991, 196);                                   //Mouse click on "Pencil Tool"
    }

    used_colors[used_colors_pointer] = actual_pixel;           //Add color to the used colors array  
    used_colors_pointer++;                                     //Update 'pointer'
    
    if (n==0) {                                                //Only click on pixel brush first time if multiple textures
      moveMouseTo(940, 375);                                   //Mouse click on "Pixel Brush"
    }

    // -------------------------------------------------------------------------------------------------------------------
    
    #if defined(MASK_ENABLED)                                  //If MASK_ENABLE initialize array for each texture iterarion
	  mask_reset();
    for (int index=1; index<4097; index++) {
      #if defined(SPI_ON)  
        if (texture.read()==actual_pixel) {
          mask_set(index);                                           // 'true' values if it's the background color
        }
      #else 
        if (pgm_read_byte_near(image + (image_index*4097) + index)==actual_pixel) {
		  mask_set(index);                                           // 'true' values if it's the background color
		}
      #endif    
    }
    #endif
    
     // -------------------------------------------------------------------------------------------------------------------

    for (int index=1; index<4097; index++) {
      #if defined(SPI_ON)
      texture.seek(index);
      byte pixel_color = texture.read();
      #else 
      byte pixel_color = pgm_read_byte_near(image + (image_index*4097)+ index);
      #endif
    
      used_color = false;
      for (int j=0; j<134; j++) {   
        if(used_colors[j] == pixel_color) {
          used_color = true;
          break;
        }
      }
    
      if (!used_color) {
        used_colors[used_colors_pointer] = pixel_color;

        used_colors_pointer++;
        moveMouseTo(1187, 544);              //Mouse click to open  "Palette gear tool/Colour Palette"
        getColor(pixel_color);               //Get color from the Palette
        
        moveMouseTo(1221, 55);               //Mouse click on "X" to exit palette    
        delay(delay_mouse);
        
        for (int k=index; k<4097; k++) {
          #if defined(SPI_ON) 
          texture.seek(k);
          byte pixelData = texture.read();
          #else 
          byte pixelData = pgm_read_byte_near(image + (image_index*4097)+ k);
          #endif
        
          if (pixelData == pixel_color) {       
            pos_x = (k-1) % 64;
            pos_y = (k-1) / 64;
            MouseTo.setTarget(340+(pos_x*8), 158+(pos_y*8), false);
            while (MouseTo.move() == false) {}  delay(70+delay_move);
        
            Mouse.press(MOUSE_LEFT); delay(40+delay_mouse);

            #if defined(MASK_ENABLED)
            mask_set(k);
			      pos_x = -1;
            #endif

            int line = 0;
            while ((k-1)/64 == k/64) {
              #if defined(SPI_ON)
              pixelData = texture.read();
              #if defined(MASK_ENABLED) 
              if (pixelData == pixel_color || mask_get(k+1)==false ) {
                if (pixelData == pixel_color) {
                  mask_set(k+1);
                  pos_x = k % 64;
                }
                line++;
                k++;
              } else {
                break;
              }
              #else
              if (pixelData == pixel_color) {
                line++;
                k++;
              } else {
                break;
              }
              #endif
              #else 
              pixelData = pgm_read_byte_near(image + (image_index*4097) + k + 1);
              #if defined(MASK_ENABLED)
              if (pixelData == pixel_color || mask_get(k+1)==false) {
                if (pixelData == pixel_color) {
                  mask_set(k+1);
                  pos_x = k % 64;
                }
                line++;
                k++;
              } else {
                break;
              }
              #else
              if (pixelData == pixel_color) {
                line++;
                k++;
              } else {
                break;
              }
              #endif
              
              #endif
            }
            
			#if defined(MASK_ENABLED)
            if (line>0 && pos_x>=0) {
            #else
            if (line>0) {
              pos_x = (k-1) % 64;
            #endif
              MouseTo.setTarget(340+(pos_x*8), 158+(pos_y*8), false);
              while (MouseTo.move() == false) {}  delay(40+delay_move);
            }

            Mouse.release(MOUSE_LEFT); delay(35+delay_mouse);
          }
          
        }  
      }       
      
    }
    moveMouseTo(1221, 55);      //Mouse click on "X" to exit palette   
    delay(delay_mouse);

    #if defined(SPI_ON)
    texture.close();
    #else
    image_index++;
    #endif
  }

  while(1) {
    digitalWrite(LED_BUILTIN, HIGH);
    delay(500);
    digitalWrite(LED_BUILTIN, LOW);
    delay(500);
  }
  
}


// Aux functions
// ----------------------------------------------------------------------------------------------------


void clickMouse() {
  delay(70+delay_move);
  Mouse.press(MOUSE_LEFT);
  delay(40+delay_mouse);
  Mouse.release(MOUSE_LEFT);
  delay(40+delay_mouse);
}

void moveMouseTo (int x, int y) {
  MouseTo.setTarget(x, y, false);
  while (MouseTo.move() == false) {}
  clickMouse();  
}

void createTextureNodon(byte n) {
  MouseTo.setTarget(948, 694, false);  while (MouseTo.move() == false) {}
  if (n==0) {
    for (byte i=0; i<16; i++) clickMouse();
  } else {
    for (byte i=0; i<2; i++) clickMouse();
  } 
  moveMouseTo(358, 694);      //Objects
  moveMouseTo(358, 330);      //Special Objects
  moveMouseTo(488, 570);      //Texture
  delay(300+delay_move);      // An small delay to be sure the nodon is being created due possible lag on the code screen
  moveMouseTo(550, 568);      //Edit Texture Gear icon    
}


void clearUsedColorsArray() {
  used_colors_pointer = 0;
  for (byte i=0; i<135; i++) {
    used_colors[i]=255;      //set initial value to a not existing color
  }
}


void getColor(int color_pos){
  int column = color_pos % 15;
  int row = color_pos / 15;
  int pos_x = 84+(column*48)+((column/3)*16);
  int pos_y = 175+(row*48)+((row/3)*16);

  moveMouseTo(pos_x, pos_y);      //Move mouse to color coords. and click on it
}


// Scrubz bitwise functions
#if defined(MASK_ENABLED)

void mask_reset() {
    for (int i = 0; i < 513; i++) s_mask[i] = 0;
}


void mask_set(int index) {
    s_mask[index / 8] |= 1 << index % 8;
}


bool mask_get(int index) {
    return !!(1 << index % 8 & s_mask[index / 8]);
}

#endif
// ----------------------------------------------------------------------------------------------------
